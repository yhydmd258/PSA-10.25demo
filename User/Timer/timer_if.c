/******************************************************************************								
*  Name: Timer_if.c
*  Description: 
*  Project: C_demo
*  Auther:  shanghai tianma
*              R&D center
*              penghu
*  MCU: S9KEAZ128AMLH
*  Comment:
******************************************************************************/		
#include "../Command/command.h"
#include "timer_if.h"

/**********************************************************************************************
* External objects
**********************************************************************************************/


/**********************************************************************************************
* Global variables
**********************************************************************************************/

/**********************************************************************************************
* Constants and macros
**********************************************************************************************/

/**********************************************************************************************
* Local types
**********************************************************************************************/


/**********************************************************************************************
* Local function prototypes
*********************************************************************************************/

/**********************************************************************************************
* Local variables
**********************************************************************************************/
static uint32_t  Timer_Byte[END_OF_TIMER_BYTE] = {0};

/**********************************************************************************************
* Local functions
**********************************************************************************************/


/**********************************************************************************************
* Global functions
**********************************************************************************************/
/***********************************************************************************************
*
* @brief    Timer_If_Count() - It will been called every 2ms
* @param    none
* @return   none
*
************************************************************************************************/
void Timer_If_Count(void)
{
    uint8_t number;

    for(number=0; number<END_OF_TIMER_BYTE; number++)
    {
        if(TIMER_UP != Timer_Byte[number])
            Timer_Byte[number]--;
    }
}

/***********************************************************************************************
*
* @brief    Timer_If_Set() - set the time for the timer event 
* @param    en_timer: event
                 time: the time of the event
* @return   none
*
************************************************************************************************/
void Timer_If_Set(EN_TIMER_BYTE en_timer,uint32_t time)
{
    if( END_OF_TIMER_BYTE > en_timer )
        Timer_Byte[en_timer] = time;
}

/***********************************************************************************************
*
* @brief    Timer_If_Set() - clear the time for the timer event 
* @param    en_timer: event
* @return   none
*
************************************************************************************************/
void Timer_If_Clear(EN_TIMER_BYTE en_timer)
{
    if( END_OF_TIMER_BYTE > en_timer )
        Timer_Byte[en_timer] = TIMER_UP;
}

/***********************************************************************************************
*
* @brief    Timer_If_Check() - check the time of  "en_timer" is up to TIMER_UP(0)
* @param    en_timer: event
* @return   TRUE: the time is up to TIMER_UP(0)
*               FALSE: the time is not up to TIMER_UP(0)
*
************************************************************************************************/
uint8_t Timer_If_Check(EN_TIMER_BYTE en_timer)
{
    uint8_t result;
    
    if(END_OF_TIMER_BYTE > en_timer)
    {
        if(TIMER_UP == Timer_Byte[en_timer])
            result = TRUE;              /* the time is up to TIMER_UP(0) */
        else
            result = FALSE;             /* the time is not up to TIMER_UP(0) */
    }
    else
    {
        result = FALSE;
    }

    return result;
}

/***********************************************************************************************
*
* @brief    Timer_If_Delay() - synchronous timing
* @param    none
* @return   none
*
************************************************************************************************/
void Timer_If_Delay(uint32_t delay_time)
{
    while(delay_time--);
}

